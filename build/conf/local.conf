## build/conf/local.conf
```bitbake
#
# This file is your local configuration file and is where all local user settings
# are placed. The comments in this file give some guide to the options a new user
# to the system might want to change but pretty much any configuration option can
# be set in this file. More adventurous users can look at local.conf.extended
# which contains other examples of configuration which can be placed in this file
# but new users likely won't need any of them initially.
#
# Lines starting with the '#' character are commented out and in some cases the
# default values are provided as comments to show people example syntax. Enabling
# the option is a question of removing the # character and making any change to the
# variable as required.


MACHINE ?= "beaglebone"
BBMASK ?= ".*/meta-ti/recipes-misc/(images|payload)/"

# This sets the default machine to be qemux86 if no other machine is selected:
#MACHINE ??= "qemux86"

#DL_DIR ?= "${TOPDIR}/downloads"

#DISTRO ?= "farbsort"
DISTRO ?= "poky"

PACKAGE_CLASSES ?= "package_rpm"

EXTRA_IMAGE_FEATURES ?= "debug-tweaks"

USER_CLASSES ?= "buildstats image-mklibs image-prelink"

PATCHRESOLVE = "noop"

DEFAULTTUNE = "cortexa8hf-neon"

BB_DISKMON_DIRS = "\
    STOPTASKS,${TMPDIR},1G,100K \
    STOPTASKS,${DL_DIR},1G,100K \
    STOPTASKS,${SSTATE_DIR},1G,100K \
    STOPTASKS,/tmp,100M,100K \
    ABORT,${TMPDIR},100M,1K \
    ABORT,${DL_DIR},100M,1K \
    ABORT,${SSTATE_DIR},100M,1K \
    ABORT,/tmp,10M,1K"

#
# Qemu configuration
#
# By default qemu will build with a builtin VNC server where graphical output can be
# seen. The two lines below enable the SDL backend too. By default libsdl-native will
# be built, if you want to use your host's libSDL instead of the minimal libsdl built
# by libsdl-native then uncomment the ASSUME_PROVIDED line below.
PACKAGECONFIG_append_pn-qemu-native = " sdl"
PACKAGECONFIG_append_pn-nativesdk-qemu = " sdl"

CONF_VERSION = "1"

PREFERRED_PROVIDER_u-boot = "u-boot-ti-staging"
PREFERRED_PROVIDER_linux = "linux-ti-staging"
PREFERRED_PROVIDER_virtual/kernel = "linux-ti-staging"

PACKAGECONFIG_append_pn-qtbase = "linuxfb accessibility gles2 openss icu udev widgets pulseaudio sql-sqlite sql-sqlite2 alsa"
PACKAGECONFIG[gles2] = "-opengl es2 -eglfs -qpa eglfs,,virtual/libgles2 virtual/egl"
#PACKAGECONFIG_append_pn-qtmultimedia = " gstreamer010 "
PACKAGECONFIG_remove_pn-qtbase = "msse2"
DISTRO_FEATURES_remove = "x11"
DISTRO_FEATURES_append = " opengl wayland qt5"
```
